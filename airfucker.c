// Standard includes
#include <stdio.h>
#include <string.h>
#include <stdlib.h>
#include <stdint.h>

// Simplelink includes
#include "simplelink.h"

//Driverlib includes
#include "hw_types.h"
#include "hw_ints.h"
#include "interrupt.h"
#include "utils.h"
#include "uart.h"
#include "hw_memmap.h"
#include "prcm.h"
#include "rom.h"
#include "rom_map.h"

//Common interface includes
#include "common.h"
#include "uart_if.h"

#define AF_CHANNEL_MAX          13
#define AF_CHANNEL_HOP_INTVL    500 // ms

u8 ch_hoop[] = { 1, 6, 11, 3, 8, 13, 5, 10, 2, 7, 12, 4, 9 };

uint8_t RawData_Ping[] = {
       /*---- wlan header start -----*/
       0x88,                                /* version , type sub type */
       0x02,                                /* Frame control flag */
       0x2C, 0x00,
       0x00, 0x23, 0x75, 0x55,0x55, 0x55,   /* destination */
       0x00, 0x22, 0x75, 0x55,0x55, 0x55,   /* bssid */
       0x08, 0x00, 0x28, 0x19,0x02, 0x85,   /* source */
       0x80, 0x42, 0x00, 0x00,
       0xAA, 0xAA, 0x03, 0x00, 0x00, 0x00, 0x08, 0x00, /* LLC */
       /*---- ip header start -----*/
       0x45, 0x00, 0x00, 0x54, 0x96, 0xA1, 0x00, 0x00, 0x40, 0x01,
       0x57, 0xFA,                          /* checksum */
       0xc0, 0xa8, 0x01, 0x64,              /* src ip */
       0xc0, 0xa8, 0x01, 0x02,              /* dest ip  */
       /* payload - ping/icmp */
       0x08, 0x00, 0xA5, 0x51,
       0x5E, 0x18, 0x00, 0x00, 0x41, 0x08, 0xBB, 0x8D, 0x00, 0x00, 0x00, 0x00,
       0x00, 0x00, 0x00, 0x00, 0x00, 0x00, 0x00, 0x00, 0x00, 0x00, 0x00, 0x00,
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       0x00, 0x00, 0x00, 0x00};

typedef struct __Mac_Addr_ {
    uint8_t addr[6];
} Mac_Addr

Mac_Addr victim_list[] = {
    { 0x0c, 0x49,  51, 0x88, 0xc3, 0x11 },
    { 0xcc, 0x08, 251, 0x61, 0x03, 0x8e },
    { 0xcc, 0x08, 251, 0x61, 0x03, 0x90 },
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    { 0x78, 0x11, 220, 0x4b, 0x90, 0xba },
};

uint32_t victim_tbl_hash[MAX_HASH_TBL] = { 0 };
uint32_t victim_tbl_len = 0;

extern uVectorEntry __vector_table;

static void platform_init(void)
{
    MAP_IntVTableBaseSet((unsigned long)&__vector_table);

    MAP_IntMasterEnable();
    MAP_IntEnable(FAULT_SYSTICK);

    PRCMCC3200MCUInit();
    
    PinMuxConfig();
}

void af_init(void)
{
    // calc mac hashs
    for (victim_tbl_len = 0; victim_tbl_len < sizeof(victim_list)/sizeof(Mac_Addr);
         victim_tbl_len ++)
    {
        victim_tbl_hash[victim_tbl_len] = (uint32_t)(*(((uint8_t)&victim_list[victim_tbl_len]) + 1));
    }
}

void hop(void)
{
    // hopping:
    for (i_ch = 1; i_ch <= AF_CHANNEL_MAX; i_ch ++)
    {
        while (1)
        {
            g_el_sock = sl_Socket(SL_AF_RF, SL_SOCK_RAW, ch_hoop[i_ch]);
            if (g_el_sock == SL_EALREADY_ENABLED)   // close in progress..
            {
                mico_thread_msleep(MICO32_EASYLINK_LIB_CHANNEL_HOPPING_BREATH);
            }
            else
            {
                break;
            }
        }
    }
}

void fuck(void)
{
    // listen for a while, extract Mac Info
}

int main()
{
    platform_init();
    
    InitTerm();

    af_init();
    af_reset_wifi();
    af_fuck(victim_tbl_hash, victim_tbl_len);

    LOOP_FOREVER();
}
